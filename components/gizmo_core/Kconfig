## components/gizmo_core/Kconfig
```kconfig
menu "Gizmo core"

    config GIZMO_HMI_COUNTS_PER_STEP
        int "Module HMI encoder counts per detent"
        range 1 8
        default 1
        help
            Raw encoder counts the Module HMI reports for one mechanical click.
            If one click moves focus by more than one item, raise this.
            Enable debug logging for tag "hmi" to see raw deltas.

    config GIZMO_HMI_REVERSE
        bool "Reverse Module HMI encoder direction"
        default n

    config GIZMO_NTP_SERVER
        string "NTP server"
        default "pool.ntp.org"
        help
            Queried once Wi-Fi is connected; lwIP re-syncs periodically.

    config GIZMO_DEFAULT_TIMEZONE
        string "Default timezone (IANA name)"
        default "Etc/UTC"
        help
            Used until a timezone is picked in Settings -> Network, e.g.
            "Asia/Singapore", "Europe/Berlin", "America/New_York".
            Must be one of the zones in components/gizmo_core/timezones.c;
            unknown names fall back to Etc/UTC.

    config GIZMO_LED_GPIO
        int "Bottom3 RGB LED data GPIO"
        default 5
        help
            WS2812 data line of the M5GO Bottom3 base. Its pin map labels
            M-Bus pin 8 "RGB", which is GPIO5 on CoreS3.

    config GIZMO_LED_COUNT
        int "Number of RGB LEDs"
        range 1 64
        default 10

    config GIZMO_LED_BRIGHTNESS
        int "VU meter LED brightness (0-255)"
        range 1 255
        default 48

    config GIZMO_VU_SWAP_MICS
        bool "VU meter: swap microphone channels"
        default n
        help
            Treat I2S channel 1 as the left microphone instead of channel 0.

endmenu
```
